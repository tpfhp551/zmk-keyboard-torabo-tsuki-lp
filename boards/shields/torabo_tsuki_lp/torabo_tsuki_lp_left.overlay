#include "torabo_tsuki_lp.dtsi"
#include <input/processors.dtsi>
#include <dt-bindings/zmk/input_transform.h>

&zip_temp_layer {
    excluded-positions = <
        33 // J
        34 // K
        35 // L
        36 // :
        48 // ,
        50 // /
        58 // space left3
        59 // space right1
    >;
};

&trackball_listener {
    input-processors = <
        &zip_xy_transform (INPUT_TRANSFORM_X_INVERT | INPUT_TRANSFORM_Y_INVERT)
        &zip_temp_layer 1 10000
    >;
};
